## components/button/Kconfig
```kconfig
menu "IoT Button"

    config BUTTON_PERIOD_TIME_MS
        int "BUTTON PERIOD TIME (MS)"
        range 2 500
        default 10
        help
            "Button scan interval"

    config BUTTON_DEBOUNCE_TICKS
        int "BUTTON DEBOUNCE TICKS"
        range 1 7
        default 2
        help
            "One CONFIG_BUTTON_DEBOUNCE_TICKS equal to CONFIG_BUTTON_PERIOD_TIME_MS"

    config BUTTON_SHORT_PRESS_TIME_MS
        int "BUTTON SHORT PRESS TIME (MS)"
        range 50 800
        default 180

    config BUTTON_LONG_PRESS_TIME_MS
        int "BUTTON LONG PRESS TIME (MS)"
        range 500 5000
        default 1500

    config BUTTON_LONG_PRESS_TOLERANCE_MS
        int "BUTTON LONG PRESS TOLERANCE TIME (MS)"
        default 20

    config BUTTON_SERIAL_TIME_MS
        int "BUTTON SERIAL TIME (MS)"
        range 2 1000
        default 20
        help
            "Serial trigger interval"

endmenu
```

## components/led_indicator/Kconfig
```kconfig
menu "LED Indicator"

    config BRIGHTNESS_TICKS
        int "One brightness change for ticks"
        range 1 50
        default 10

    config USE_GAMMA_CORRECTION
        bool "Enable gamma correction"
        default "y"

    menu "LEDC Config"

        choice LEDC_SPEED_MODE
            prompt "LEDC Speed Mode"
            default LEDC_LOW_SPEED_MODE

        config LEDC_HIGH_SPEED_MODE
            bool "LEDC high speed mode"
        config LEDC_LOW_SPEED_MODE
            bool "LEDC low speed mode"
        endchoice

        config LEDC_SPEED_MODE_VALUE
            int
            default 1 if LEDC_LOW_SPEED_MODE
            default 0 if LEDC_HIGH_SPEED_MODE

        config LEDC_TIMER_BIT_NUM
            int "LEDC Timer Bit Num"
            default 13
            range 1 20
            help
                The bit number of LEDC timer (1 - SOC_LEDC_TIMER_BIT_WIDE_NUM)

        config LEDC_TIMER_FREQ_HZ
            int "LEDC Timer Frequency"
            default 5000
            help
                The frequency of LEDC timer (1 - 40000000)
    endmenu

endmenu
```
